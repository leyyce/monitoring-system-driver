/dts-v1/;
/plugin/;
/ {
    fragment@0 {
        target-path = "/";
        __overlay__ {
            monitoring-system {
                compatible = "embedded_linux,monitoring_system";
                status = "okay";
                msd-gpio = <&gpio 82 0>;
                msc-gpio = <&gpio 68 0>;
            };
        };
    };
};